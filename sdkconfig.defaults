## sdkconfig.defaults
```kconfig
CONFIG_ESPTOOLPY_FLASHSIZE_16MB=y
CONFIG_ESPTOOLPY_FLASHSIZE="16MB"
CONFIG_PARTITION_TABLE_SINGLE_APP=y
CONFIG_PARTITION_TABLE_OFFSET=0x8000
CONFIG_ESPTOOLPY_FLASH_FREQ_80M=y
CONFIG_ESPTOOLPY_FLASHSIZE_DETECT=y

CONFIG_PTHREAD_task_STACK_SIZE_DEFAULT=65536
CONFIG_PTHREAD_STACK_MIN=32768
CONFIG_FREERTOS_TASK_STACK_SIZE=65536
CONFIG_ESP_MAIN_TASK_STACK_SIZE=65536
CONFIG_ESP_TASK_WDT_TIMEOUT_S=10
CONFIG_FREERTOS_IDLE_TASK_STACKSIZE=8192
CONFIG_PTHREAD_TASK_STACK_FROM_PSRAM=y
CONFIG_SPIRAM_ALLOW_STACK_IN_EXTERNAL_MEMORY=y
CONFIG_SPIRAM=y
CONFIG_SPIRAM_CACHE_WORKAROUND=y
CONFIG_SPIRAM_USE_MALLOC=y

CONFIG_FREERTOS_USE_TRACE_FACILITY=1

CONFIG_TWAI_ERRATA_FIX_RX_FRAME_INVALID=y
CONFIG_TWAI_ERRATA_FIX_TX_INTR_LOST=y
CONFIG_TWAI_ERRATA_FIX_RX_FIFO_CORRUPT=y
CONFIG_TWAI_ERRATA_FIX_BUS_OFF_REC=y
CONFIG_TWAI_ERRATA_FIX_RX_MISS_CNT=y
CONFIG_TWAI_ERRATA_FIX_ARB_LOST=y
CONFIG_TWAI_ERRATA_FIX_RX_ACK=y
```
